## linux-4.15/fs/flatfs/Kconfig
```kconfig
config FLATFS_FS
	tristate "FlatFS: A Metadata-Optimized NVM File System"
	depends on FS_DAX
	select CRC16
	help
	   If your system has a block of fast (comparable in access speed to
	   system memory) and non-volatile byte-addressable memory and you wish to
	   mount a light-weight, full-featured, and space-efficient filesystem over
	   it, say Y here.

	   To compile this as a module,  choose M here: the module will be
	   called flatfs.
```
